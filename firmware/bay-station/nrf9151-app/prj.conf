## CMakeLists.txt
```
# Bay station host application (nRF9151). Target: NCS v3.4.x (LTS).
#   west build -b bay_station_lte/nrf9151/ns firmware/bay-station/nrf9151-app
# Not built yet: no SDK in the environment this was written in.
cmake_minimum_required(VERSION 3.20.0)

# Out-of-tree board + project bindings live in firmware/.
get_filename_component(UWBRL_FW_ROOT ${CMAKE_CURRENT_LIST_DIR}/../.. ABSOLUTE)
list(APPEND BOARD_ROOT ${UWBRL_FW_ROOT})
list(APPEND DTS_ROOT ${UWBRL_FW_ROOT})

find_package(Zephyr REQUIRED HINTS $ENV{ZEPHYR_BASE})
project(uwbrl_bay_station_lte)

target_include_directories(app PRIVATE ${UWBRL_FW_ROOT}/common/include src)
target_sources(app PRIVATE
  src/main.c
  src/uwb_array.c
  src/bridge_link.c
  src/lte_gnss.c
  ${UWBRL_FW_ROOT}/common/src/bridge_proto.c
)
target_sources_ifdef(CONFIG_UWBRL_BRINGUP_SHELL app PRIVATE src/bringup_shell.c)
```

## Kconfig
```
menu "UWB rescue locator bay station (nRF9151)"

config UWBRL_BRINGUP_SHELL
	bool "Board bring-up shell commands ('bringup ...') on DBG_UART"
	default y
	select SHELL
	help
	  Per-block tests used by docs/verification-plan.md. Keep enabled on
	  every hardware revision until the board passes system tests.

config UWBRL_UWB_SPI_SLOW_HZ
	int "Anchor SPI clock before the DW3000 leaves INIT_RC (Hz)"
	default 2000000
	help
	  DW3000 Datasheet v1.1 Table 21: SPI is limited to 7 MHz while the
	  chip runs from its RC oscillator in INIT_RC. Bring-up uses a margin
	  well below that.

config UWBRL_BRIDGE_PING_TIMEOUT_MS
	int "Bridge ping timeout (ms)"
	default 200

endmenu

source "Kconfig.zephyr"
```

## prj.conf
```kconfig
# Bay station host (nRF9151). Kconfig names to be re-checked against the
# pinned NCS release on first build.

# Logging + shell on DBG_UART (uart0)
CONFIG_LOG=y
CONFIG_SHELL=y
CONFIG_SHELL_BACKEND_SERIAL=y

# Peripherals
CONFIG_GPIO=y
CONFIG_SPI=y
CONFIG_I2C=y
CONFIG_ADC=y
CONFIG_SERIAL=y
CONFIG_UART_INTERRUPT_DRIVEN=y

# Modem: library, link control, GNSS. Modem firmware is Nordic's binary,
# flashed separately -- see bay-station/README.md "Modem firmware".
CONFIG_NRF_MODEM_LIB=y
CONFIG_LTE_LINK_CONTROL=y
# 'at' shell command for raw AT access during bring-up (NCS AT shell lib).
CONFIG_AT_SHELL=y

# Calibration table storage (fw-m6). Off until the store is written.
# CONFIG_FLASH=y
# CONFIG_FLASH_MAP=y
# CONFIG_NVS=y
# CONFIG_SETTINGS=y

CONFIG_MAIN_STACK_SIZE=4096
CONFIG_SHELL_STACK_SIZE=4096
```

## boards/bay_station_lte_nrf9151_ns.conf
```kconfig
# TF-M's log UART defaults to UARTE1, which this board uses for the BLE
# bridge. Silence TF-M logging so it never claims the instance.
# Option name per NCS TF-M docs -- verify on the pinned release.
CONFIG_TFM_LOG_LEVEL_SILENCE=y
```

## src/main.c
```c
/*
 * Bay station host (nRF9151). Skeleton: brings up each block and leaves the
 * bring-up shell running on DBG_UART. The exchange scheduler, timestamp
 * collection, calibration store and uplink policy are milestones fw-m4..m8
 * in firmware/README.md and are deliberately absent, not stubbed to look
 * done.
 */
#include <zephyr/drivers/gpio.h>
#include <zephyr/kernel.h>
#include <zephyr/logging/log.h>

#include "bridge_link.h"
#include "lte_gnss.h"
#include "uwb_array.h"

LOG_MODULE_REGISTER(main, LOG_LEVEL_INF);

static const struct gpio_dt_spec led_sys = GPIO_DT_SPEC_GET(DT_ALIAS(led_sys), gpios);

int main(void)
{
	int err;

	gpio_pin_configure_dt(&led_sys, GPIO_OUTPUT_ACTIVE);

	/* Each block reports and carries on: on a new board we want the shell
	 * up even if half the blocks are dead. */
	err = uwb_array_init();
	LOG_INF("uwb_array_init: %d", err);

	err = bridge_link_init();
	LOG_INF("bridge_link_init: %d", err);

	err = lte_gnss_init();
	LOG_INF("lte_gnss_init: %d", err);

	LOG_INF("bay station up; 'bringup' shell on DBG_UART");

	for (;;) {
		gpio_pin_toggle_dt(&led_sys); /* heartbeat */
		k_sleep(K_MSEC(500));
	}
	return 0;
}
```

## src/bridge_link.c
```c
#include "bridge_link.h"

#include <errno.h>
#include <string.h>
#include <zephyr/device.h>
#include <zephyr/devicetree.h>
#include <zephyr/drivers/gpio.h>
#include <zephyr/drivers/uart.h>
#include <zephyr/kernel.h>
#include <zephyr/logging/log.h>
#include <zephyr/sys/ring_buffer.h>

LOG_MODULE_REGISTER(bridge_link, LOG_LEVEL_INF);

#define BRIDGE_NODE DT_NODELABEL(bridge_ctrl)

static const struct device *const uart = DEVICE_DT_GET(DT_PHANDLE(BRIDGE_NODE, uart));
static const struct gpio_dt_spec irq = GPIO_DT_SPEC_GET(BRIDGE_NODE, irq_gpios);
static const struct gpio_dt_spec rst = GPIO_DT_SPEC_GET(BRIDGE_NODE, reset_gpios);

RING_BUF_DECLARE(rx_ring, 1024);
static K_SEM_DEFINE(rx_sem, 0, 1);
static K_SEM_DEFINE(pong_sem, 0, 1);
static K_MUTEX_DEFINE(tx_lock);

static struct uwbrl_rx rx_state;
static uint8_t tx_seq;
static uint8_t ping_seq;
static uint8_t pong_buf[UWBRL_MAX_PAYLOAD];
static uint16_t pong_len;

static void uart_isr(const struct device *dev, void *user_data)
{
	ARG_UNUSED(user_data);
	while (uart_irq_update(dev) && uart_irq_is_pending(dev)) {
		if (uart_irq_rx_ready(dev)) {
			uint8_t b[32];
			int n = uart_fifo_read(dev, b, sizeof(b));

			if (n > 0 && ring_buf_put(&rx_ring, b, n) < (uint32_t)n) {
				/* Ring full: RTS deasserts in HW before this in normal
				 * operation; count it if it ever happens. TODO(fw-m2). */
			}
			k_sem_give(&rx_sem);
		}
	}
}

static int send_seq(uint8_t type, uint8_t seq, uint8_t flags, const void *payload, uint16_t len);

static void handle_frame(const struct uwbrl_hdr *h, const uint8_t *p)
{
	switch (h->type) {
	case UWBRL_T_PONG:
		if (h->seq == ping_seq && h->len <= sizeof(pong_buf)) {
			memcpy(pong_buf, p, h->len);
			pong_len = h->len;
			k_sem_give(&pong_sem);
		}
		break;
	case UWBRL_T_PING:
		send_seq(UWBRL_T_PONG, h->seq, 0, p, h->len); /* PONG echoes PING's seq */
		break;
	case UWBRL_T_HELLO:
	case UWBRL_T_BLE_STATE:
		LOG_INF("bridge msg type 0x%02x len %u", h->type, h->len);
		/* TODO(fw-m2): track BLE state, drive LED / uplink policy */
		break;
	case UWBRL_T_CMD:
		/* TODO(fw-m7): laptop commands */
		break;
	default:
		LOG_WRN("unhandled bridge type 0x%02x", h->type);
	}
}

static void rx_thread(void *a, void *b, void *c)
{
	ARG_UNUSED(a); ARG_UNUSED(b); ARG_UNUSED(c);
	uint8_t byte;
	struct uwbrl_hdr h;
	const uint8_t *p;

	for (;;) {
		k_sem_take(&rx_sem, K_FOREVER);
		while (ring_buf_get(&rx_ring, &byte, 1) == 1) {
			int r = uwbrl_rx_feed(&rx_state, byte, &h, &p);

			if (r == 1) {
				handle_frame(&h, p);
			} else if (r < 0) {
				LOG_WRN("bridge rx frame error %d", r);
			}
		}
	}
}
K_THREAD_DEFINE(bridge_rx, 2048, rx_thread, NULL, NULL, NULL, 5, 0, 0);

int bridge_link_init(void)
{
	if (!device_is_ready(uart) || !gpio_is_ready_dt(&irq) || !gpio_is_ready_dt(&rst)) {
		return -ENODEV;
	}
	uwbrl_rx_init(&rx_state);
	gpio_pin_configure_dt(&irq, GPIO_INPUT);
	gpio_pin_configure_dt(&rst, GPIO_OUTPUT_INACTIVE);
	uart_irq_callback_user_data_set(uart, uart_isr, NULL);
	uart_irq_rx_enable(uart);

	struct uwbrl_hello hello = {
		.role = 1, .proto_ver = UWBRL_PROTO_VERSION,
		.max_payload = UWBRL_MAX_PAYLOAD, .fw_build_id = 0, /* TODO: git hash */
	};
	return bridge_send(UWBRL_T_HELLO, 0, &hello, sizeof(hello));
}

int bridge_send(uint8_t type, uint8_t flags, const void *payload, uint16_t len)
{
	return send_seq(type, tx_seq++, flags, payload, len);
}

static int send_seq(uint8_t type, uint8_t seq, uint8_t flags, const void *payload, uint16_t len)
{
	static uint8_t wire[UWBRL_MAX_WIRE_FRAME];

	k_mutex_lock(&tx_lock, K_FOREVER);
	size_t n = uwbrl_frame_build(type, seq, flags, payload, len, wire);

	if (n == 0) {
		k_mutex_unlock(&tx_lock);
		return -EMSGSIZE;
	}
	/* Polled TX is fine for bring-up; CTS is honoured by the UARTE in HW.
	 * TODO(fw-m2): move to async/DMA TX for the measurement stream. */
	for (size_t i = 0; i < n; i++) {
		uart_poll_out(uart, wire[i]);
	}
	k_mutex_unlock(&tx_lock);
	return 0;
}

int bridge_ping(const void *payload, uint16_t len, int timeout_ms)
{
	k_sem_reset(&pong_sem);
	ping_seq = tx_seq;
	int64_t t0 = k_uptime_ticks();
	int err = bridge_send(UWBRL_T_PING, 0, payload, len);

	if (err) {
		return err;
	}
	if (k_sem_take(&pong_sem, K_MSEC(timeout_ms))) {
		return -ETIMEDOUT;
	}
	if (pong_len != len || memcmp(pong_buf, payload, len) != 0) {
		return -EBADMSG;
	}
	return (int)k_ticks_to_us_floor64(k_uptime_ticks() - t0);
}

int bridge_reset_ble(void)
{
	gpio_pin_set_dt(&rst, 1);
	k_msleep(1);
	return gpio_pin_set_dt(&rst, 0);
}

int bridge_irq_level(void)
{
	return gpio_pin_get_dt(&irq);
}

void bridge_stats(uint32_t *ok, uint32_t *crc_err, uint32_t *cobs_err, uint32_t *len_err)
{
	*ok = rx_state.n_ok;
	*crc_err = rx_state.n_crc_err;
	*cobs_err = rx_state.n_cobs_err;
	*len_err = rx_state.n_len_err;
}
```

## src/bridge_link.h
```c
/* nRF9151 side of the BT840 bridge link (firmware/common/include/uwbrl/bridge_proto.h). */
#ifndef BRIDGE_LINK_H_
#define BRIDGE_LINK_H_

#include <stdint.h>
#include "uwbrl/bridge_proto.h"

int bridge_link_init(void);
int bridge_send(uint8_t type, uint8_t flags, const void *payload, uint16_t len);
/* PING with a payload, wait for the matching PONG. Returns round-trip us or <0. */
int bridge_ping(const void *payload, uint16_t len, int timeout_ms);
int bridge_reset_ble(void);       /* pulse RESET_BLE_N */
int bridge_irq_level(void);       /* BRIDGE_IRQ */
void bridge_stats(uint32_t *ok, uint32_t *crc_err, uint32_t *cobs_err, uint32_t *len_err);

#endif /* BRIDGE_LINK_H_ */
```

## src/bringup_shell.c
```c
/*
 * 'bringup' shell: one command per board block, used step-by-step by
 * docs/verification-plan.md (stage 6, per-block functional tests).
 *
 * Every expected value is cited or marked UNVERIFIED. A test that prints
 * "UNVERIFIED" is reporting what it read, not judging it.
 */
#include <stdlib.h>
#include <string.h>
#include <zephyr/device.h>
#include <zephyr/devicetree.h>
#include <zephyr/drivers/gpio.h>
#include <zephyr/drivers/i2c.h>
#include <zephyr/kernel.h>
#include <zephyr/shell/shell.h>

#include "bridge_link.h"
#include "lte_gnss.h"
#include "uwb_array.h"

/* ------------------------------------------------------------------ I2C */

static const struct device *const i2c = DEVICE_DT_GET(DT_NODELABEL(i2c2));

#define IIS2MDC_ADDR  DT_REG_ADDR(DT_NODELABEL(iis2mdc))
#define IIS2DLPC_ADDR DT_REG_ADDR(DT_NODELABEL(iis2dlpc))
#define MAX17048_ADDR DT_REG_ADDR(DT_NODELABEL(max17048))

/* IIS2DLPC WHO_AM_I @0x0F = 0x44: ST DocID031788 Rev 4, s8.3 "fixed at 44h"
 * and the register map. VERIFIED from the PDF. */
#define IIS2DLPC_REG_WHO_AM_I 0x0F
#define IIS2DLPC_WHO_AM_I     0x44
/* IIS2MDC WHO_AM_I @0x4F: register exists (ST DocID030986 Rev 1, s8.4, listed
 * in the contents), but the copy we could obtain stops in the SPI section,
 * before the register pages. 0x40 is the LIS2MDL value (DocID030621 Rev 5,
 * register map) and is UNVERIFIED for the IIS2MDC -- do not "fix" a board
 * that reads something else until the full PDF is checked. */
#define IIS2MDC_REG_WHO_AM_I  0x4F
#define IIS2MDC_WHO_AM_I_UNVERIFIED 0x40
/* MAX17048: VERSION and VCELL register addresses and scaling are
 * UNVERIFIED (datasheet 19-6171 download was blocked). The values below
 * are placeholders to be confirmed before trusting any pass/fail. */
#define MAX17048_REG_VCELL_PLACEHOLDER   0x02
#define MAX17048_REG_VERSION_PLACEHOLDER 0x08

static int i2c_rd8(uint16_t addr, uint8_t reg, uint8_t *v)
{
	return i2c_write_read(i2c, addr, &reg, 1, v, 1);
}

static int i2c_rd16be(uint16_t addr, uint8_t reg, uint16_t *v)
{
	uint8_t b[2];
	int err = i2c_write_read(i2c, addr, &reg, 1, b, 2);

	*v = (uint16_t)((b[0] << 8) | b[1]);
	return err;
}

static int cmd_i2c_scan(const struct shell *sh, size_t argc, char **argv)
{
	ARG_UNUSED(argc); ARG_UNUSED(argv);
	int found = 0;

	/* 1-byte read probe: TWIM does not do zero-length transfers well.
	 * A read is harmless for all three devices on this bus. */
	for (uint16_t a = 0x08; a < 0x78; a++) {
		uint8_t b;

		if (i2c_read(i2c, &b, 1, a) == 0) {
			shell_print(sh, "  0x%02x ACK", a);
			found++;
		}
	}
	shell_print(sh, "%d device(s); expect 3 (IIS2MDC 0x%02x, IIS2DLPC 0x%02x, MAX17048 0x%02x)",
		    found, IIS2MDC_ADDR, IIS2DLPC_ADDR, MAX17048_ADDR);
	return found == 3 ? 0 : -EIO;
}

static int cmd_i2c_id(const struct shell *sh, size_t argc, char **argv)
{
	ARG_UNUSED(argc); ARG_UNUSED(argv);
	uint8_t v;
	uint16_t w;
	int fails = 0;

	if (i2c_rd8(IIS2DLPC_ADDR, IIS2DLPC_REG_WHO_AM_I, &v) == 0) {
		bool ok = v == IIS2DLPC_WHO_AM_I;

		shell_print(sh, "IIS2DLPC WHO_AM_I=0x%02x %s", v, ok ? "PASS" : "FAIL (want 0x44)");
		fails += !ok;
	} else {
		shell_error(sh, "IIS2DLPC no response at 0x%02x", IIS2DLPC_ADDR);
		fails++;
	}
	if (i2c_rd8(IIS2MDC_ADDR, IIS2MDC_REG_WHO_AM_I, &v) == 0) {
		shell_print(sh, "IIS2MDC  WHO_AM_I=0x%02x (UNVERIFIED expectation 0x%02x)", v,
			    IIS2MDC_WHO_AM_I_UNVERIFIED);
	} else {
		shell_error(sh, "IIS2MDC  no response at 0x%02x", IIS2MDC_ADDR);
		fails++;
	}
	if (i2c_rd16be(MAX17048_ADDR, MAX17048_REG_VERSION_PLACEHOLDER, &w) == 0) {
		shell_print(sh, "MAX17048 VERSION(?)=0x%04x (register + value UNVERIFIED)", w);
	} else {
		shell_error(sh, "MAX17048 no response at 0x%02x", MAX17048_ADDR);
		fails++;
	}
	return fails ? -EIO : 0;
}

static int cmd_rails(const struct shell *sh, size_t argc, char **argv)
{
	ARG_UNUSED(argc); ARG_UNUSED(argv);
	uint16_t w;
	char resp[64];

	/* No rail-sense net exists in docs/net-contract.md, so the host can
	 * only see rails indirectly. Measure rails with a DMM at the test pads
	 * (verification-plan stage 4); these are cross-checks. */
	if (i2c_rd16be(MAX17048_ADDR, MAX17048_REG_VCELL_PLACEHOLDER, &w) == 0) {
		shell_print(sh, "MAX17048 VCELL raw=0x%04x (scale UNVERIFIED -- see 19-6171)", w);
	}
	/* Modem's own view of VBAT (= +VBAT_LTE). TODO(fw-m1): confirm
	 * %XVBAT in the nRF91x1 AT reference for the pinned modem FW. */
	if (modem_at("AT%XVBAT", resp, sizeof(resp)) == 0) {
		shell_print(sh, "+VBAT_LTE (modem): %s", resp);
	}
	/* TODO(fw-m1): SAADC on an internal VDD channel, if the nRF9151 SAADC
	 * offers one (check PS SAADC input list) -- otherwise propose a
	 * VSYS_SENSE divider net (handoff.md). */
	return 0;
}

/* ------------------------------------------------------------------ UWB */

/*
 * DEV_ID: RIDTAG 0xDECA in [31:16], MODEL [15:8], VER [7:4], REV [3:0]
 * (dw3000_deca_regs.h DEV_ID_* masks, dwt_uwb_driver 08.02.02).
 * Non-PDoA DW3000 = 0xDECA0302 (deca_device_api.h DWT_DW3000_DEV_ID). The
 * DW3210 is the non-PDoA QFN part (DW3000 Datasheet Table 1). Not checked
 * against the DW3000 User Manual (not obtained). REV is compared loosely
 * so a silicon revision bump reads as WARN, not FAIL.
 */
#define DW3000_DEV_ID_NONPDOA 0xDECA0302u
#define DW3000_DEV_ID_REV_MASK 0x0000000Fu

static int cmd_uwb_id(const struct shell *sh, size_t argc, char **argv)
{
	unsigned int lo = 0, hi = UWBRL_N_ANCHORS - 1;
	int fails = 0;

	if (argc > 1) {
		lo = hi = (unsigned int)strtoul(argv[1], NULL, 0);
	}
	for (unsigned int i = lo; i <= hi; i++) {
		uint32_t id = 0;
		int err = uwb_read_dev_id_raw(i, &id);
		const char *role = uwb_anchor_role(i) == UWB_ROLE_CENTER ? "center" : "outer";

		if (err) {
			shell_error(sh, "A%u (%s) SPI error %d", i, role, err);
			fails++;
		} else if (id == DW3000_DEV_ID_NONPDOA) {
			shell_print(sh, "A%u (%s) DEV_ID=0x%08x PASS", i, role, id);
		} else if ((id & ~DW3000_DEV_ID_REV_MASK) ==
			   (DW3000_DEV_ID_NONPDOA & ~DW3000_DEV_ID_REV_MASK)) {
			shell_warn(sh, "A%u (%s) DEV_ID=0x%08x WARN (rev differs)", i, role, id);
		} else {
			/* 0x00000000 / 0xFFFFFFFF: MISO stuck, CS not reaching, no
			 * power, held in reset. */
			shell_error(sh, "A%u (%s) DEV_ID=0x%08x FAIL", i, role, id);
			fails++;
		}
	}
	shell_print(sh, "note: DEV_ID works on the RC oscillator; it does NOT prove the TCXO. Use 'bringup uwb clock'.");
	return fails ? -EIO : 0;
}

static int cmd_uwb_reset(const struct shell *sh, size_t argc, char **argv)
{
	ARG_UNUSED(argc); ARG_UNUSED(argv);
	shell_print(sh, "UWB_RST_N pulse: %d", uwb_array_reset());
	return 0;
}

static int cmd_uwb_irq(const struct shell *sh, size_t argc, char **argv)
{
	ARG_UNUSED(argc); ARG_UNUSED(argv);
	for (unsigned int i = 0; i < UWBRL_N_ANCHORS; i++) {
		shell_print(sh, "UWB_IRQ%u = %d", i, uwb_irq_level(i));
	}
	return 0;
}

static int cmd_uwb_clock(const struct shell *sh, size_t argc, char **argv)
{
	ARG_UNUSED(argc); ARG_UNUSED(argv);
	for (unsigned int i = 0; i < UWBRL_N_ANCHORS; i++) {
		bool locked;
		int err = uwb_clock_check(i, &locked);

		shell_print(sh, "A%u PLL lock: %s (err %d)", i,
			    err ? "n/a" : (locked ? "PASS" : "FAIL"), err);
	}
	shell_print(sh, "TODO(fw-m3): needs the driver. Until then: scope TCXO_OUT and UWB_CLK0..3 test pads.");
	return 0;
}

/* --------------------------------------------------------------- bridge */

static int cmd_bridge_ping(const struct shell *sh, size_t argc, char **argv)
{
	int n = argc > 1 ? atoi(argv[1]) : 10;
	int ok = 0;
	uint8_t pat[64];

	for (size_t i = 0; i < sizeof(pat); i++) {
		pat[i] = (uint8_t)(i * 37u); /* includes 0x00 -> exercises COBS */
	}
	for (int i = 0; i < n; i++) {
		int us = bridge_ping(pat, sizeof(pat), CONFIG_UWBRL_BRIDGE_PING_TIMEOUT_MS);

		if (us >= 0) {
			ok++;
			shell_print(sh, "ping %d: %d us", i, us);
		} else {
			shell_error(sh, "ping %d: %d", i, us);
		}
	}
	uint32_t f_ok, f_crc, f_cobs, f_len;

	bridge_stats(&f_ok, &f_crc, &f_cobs, &f_len);
	shell_print(sh, "%d/%d ok; rx frames ok=%u crc=%u cobs=%u len=%u; BRIDGE_IRQ=%d",
		    ok, n, f_ok, f_crc, f_cobs, f_len, bridge_irq_level());
	return ok == n ? 0 : -EIO;
}

static int cmd_bridge_reset(const struct shell *sh, size_t argc, char **argv)
{
	ARG_UNUSED(argc); ARG_UNUSED(argv);
	shell_print(sh, "RESET_BLE_N pulse: %d (expect a HELLO from the BT840)", bridge_reset_ble());
	return 0;
}

/* ---------------------------------------------------------------- modem */

static int cmd_modem_check(const struct shell *sh, size_t argc, char **argv)
{
	ARG_UNUSED(argc); ARG_UNUSED(argv);
	/* Modem FW version first: the app is only valid against the modem FW
	 * versions listed in Nordic's nRF9151 compatibility matrix. */
	static const char *const cmds[] = {
		"AT+CGMR", "AT%XSYSTEMMODE?", "AT+CFUN?", "AT%XMONITOR", "AT+CEREG?",
	};
	char resp[256];

	for (size_t i = 0; i < ARRAY_SIZE(cmds); i++) {
		int err = modem_at(cmds[i], resp, sizeof(resp));

		shell_print(sh, "%s -> %s", cmds[i], err ? "ERROR" : resp);
	}
	return 0;
}

static int cmd_gnss(const struct shell *sh, size_t argc, char **argv)
{
	int timeout = argc > 1 ? atoi(argv[1]) : 300;
	struct gnss_snapshot s;

	shell_print(sh, "GNSS-only (LTE off), cold start, up to %d s, needs sky view...", timeout);
	int err = gnss_bringup_fix(timeout, &s);

	shell_print(sh, "tracked=%u best_cn0=%u.%u dB-Hz (unit UNVERIFIED)", s.n_tracked,
		    s.best_cn0_dbhz_x10 / 10, s.best_cn0_dbhz_x10 % 10);
	if (!err) {
		shell_print(sh, "FIX %.6f, %.6f alt %.1f m acc %.1f m", s.lat_deg, s.lon_deg,
			    (double)s.alt_m, (double)s.accuracy_m);
	} else {
		shell_error(sh, "no fix: %d", err);
	}
	return err;
}

/* -------------------------------------------------------- LEDs, button */

static const struct gpio_dt_spec led_sys = GPIO_DT_SPEC_GET(DT_ALIAS(led_sys), gpios);
static const struct gpio_dt_spec led_lte = GPIO_DT_SPEC_GET(DT_ALIAS(led_lte), gpios);
static const struct gpio_dt_spec btn = GPIO_DT_SPEC_GET(DT_ALIAS(btn_user), gpios);

static int cmd_led(const struct shell *sh, size_t argc, char **argv)
{
	if (argc < 3) {
		shell_error(sh, "usage: bringup led <sys|lte> <on|off>");
		return -EINVAL;
	}
	const struct gpio_dt_spec *l = strcmp(argv[1], "lte") == 0 ? &led_lte : &led_sys;

	gpio_pin_configure_dt(l, GPIO_OUTPUT);
	return gpio_pin_set_dt(l, strcmp(argv[2], "on") == 0);
}

static int cmd_btn(const struct shell *sh, size_t argc, char **argv)
{
	ARG_UNUSED(argc); ARG_UNUSED(argv);
	gpio_pin_configure_dt(&btn, GPIO_INPUT);
	shell_print(sh, "BTN_USER now %d; press within 10 s...", gpio_pin_get_dt(&btn));
	for (int i = 0; i < 1000; i++) {
		if (gpio_pin_get_dt(&btn) == 1) {
			shell_print(sh, "BTN_USER pressed: PASS");
			return 0;
		}
		k_msleep(10);
	}
	shell_error(sh, "BTN_USER: no press seen");
	return -ETIMEDOUT;
}

#define SIRQ DT_NODELABEL(sensor_irqs)
#define SIRQ_SPEC(node, prop, idx) GPIO_DT_SPEC_GET_BY_IDX(node, prop, idx),
static const struct gpio_dt_spec sensor_lines[] = { DT_FOREACH_PROP_ELEM(SIRQ, gpios, SIRQ_SPEC) };
static const char *const sensor_names[] = DT_PROP(SIRQ, gpio_names);

static int cmd_lines(const struct shell *sh, size_t argc, char **argv)
{
	ARG_UNUSED(argc); ARG_UNUSED(argv);
	for (size_t i = 0; i < ARRAY_SIZE(sensor_lines); i++) {
		gpio_pin_configure_dt(&sensor_lines[i], GPIO_INPUT);
		shell_print(sh, "%-9s = %d", sensor_names[i], gpio_pin_get_dt(&sensor_lines[i]));
	}
	return 0;
}

/* ---------------------------------------------------------------- table */

SHELL_STATIC_SUBCMD_SET_CREATE(sub_i2c,
	SHELL_CMD(scan, NULL, "Probe 0x08-0x77 on I2C_SCL/I2C_SDA", cmd_i2c_scan),
	SHELL_CMD(id, NULL, "WHO_AM_I / VERSION for IIS2DLPC, IIS2MDC, MAX17048", cmd_i2c_id),
	SHELL_SUBCMD_SET_END);

SHELL_STATIC_SUBCMD_SET_CREATE(sub_uwb,
	SHELL_CMD_ARG(id, NULL, "[anchor] raw DEV_ID read per DW3210", cmd_uwb_id, 1, 1),
	SHELL_CMD(reset, NULL, "Pulse shared UWB_RST_N", cmd_uwb_reset),
	SHELL_CMD(irq, NULL, "Read UWB_IRQ0..3 levels", cmd_uwb_irq),
	SHELL_CMD(clock, NULL, "Reference-clock / PLL lock per anchor (TODO)", cmd_uwb_clock),
	SHELL_SUBCMD_SET_END);

SHELL_STATIC_SUBCMD_SET_CREATE(sub_bridge,
	SHELL_CMD_ARG(ping, NULL, "[n] PING/PONG over BRIDGE_* UART", cmd_bridge_ping, 1, 1),
	SHELL_CMD(reset, NULL, "Pulse RESET_BLE_N", cmd_bridge_reset),
	SHELL_SUBCMD_SET_END);

SHELL_STATIC_SUBCMD_SET_CREATE(sub_bringup,
	SHELL_CMD(rails, NULL, "Indirect rail readings (fuel gauge, modem VBAT)", cmd_rails),
	SHELL_CMD(i2c, &sub_i2c, "Sensor bus", NULL),
	SHELL_CMD(uwb, &sub_uwb, "DW3210 anchors", NULL),
	SHELL_CMD(bridge, &sub_bridge, "BT840 bridge link", NULL),
	SHELL_CMD(modem, NULL, "AT+CGMR, %XSYSTEMMODE?, +CFUN?, %XMONITOR, +CEREG?", cmd_modem_check),
	SHELL_CMD_ARG(gnss, NULL, "[timeout_s] GNSS-only fix + C/N0", cmd_gnss, 1, 1),
	SHELL_CMD_ARG(led, NULL, "<sys|lte> <on|off>", cmd_led, 3, 0),
	SHELL_CMD(btn, NULL, "Wait for BTN_USER press", cmd_btn),
	SHELL_CMD(lines, NULL, "Read MAG_INT, ACC_INT1/2, FG_ALRT", cmd_lines),
	SHELL_SUBCMD_SET_END);

SHELL_CMD_REGISTER(bringup, &sub_bringup, "Bay-station board bring-up tests", NULL);
```

## src/lte_gnss.c
```c
#include "lte_gnss.h"

#include <errno.h>
#include <string.h>
#include <zephyr/kernel.h>
#include <zephyr/logging/log.h>
#include <modem/nrf_modem_lib.h>
#include <nrf_modem_at.h>
#include <nrf_modem_gnss.h>

LOG_MODULE_REGISTER(lte_gnss, LOG_LEVEL_INF);

static K_SEM_DEFINE(pvt_sem, 0, 1);

static void gnss_evt(int event)
{
	if (event == NRF_MODEM_GNSS_EVT_PVT) {
		k_sem_give(&pvt_sem);
	}
}

int lte_gnss_init(void)
{
	int err = nrf_modem_lib_init();

	if (err) {
		LOG_ERR("nrf_modem_lib_init: %d", err);
		return err;
	}
	/*
	 * %XSYSTEMMODE=<LTE-M>,<NB-IoT>,<GNSS>,<pref>: LTE-M + GNSS, no NB-IoT,
	 * prefer LTE-M. "Allowed only before activating the modem using
	 * +CFUN=1" (nRF91x1 AT Commands Reference, %XSYSTEMMODE set command).
	 * NB-IoT off is a proposal, not a decision -- see handoff.md.
	 */
	err = nrf_modem_at_printf("AT%%XSYSTEMMODE=1,0,1,1");
	if (err) {
		LOG_ERR("XSYSTEMMODE: %d", err);
	}
	return err;
}

int modem_at(const char *cmd, char *resp, size_t resp_len)
{
	return nrf_modem_at_cmd(resp, resp_len, "%s", cmd);
}

int gnss_bringup_fix(int timeout_s, struct gnss_snapshot *out)
{
	struct nrf_modem_gnss_pvt_data_frame pvt;
	int err;

	memset(out, 0, sizeof(*out));
	/* GNSS-only functional mode, LTE stays off: the bring-up case where the
	 * antenna and front end are tested without the time-sharing question.
	 * TODO(fw-m8): confirm CFUN=31 semantics in the nRF91x1 AT reference. */
	err = nrf_modem_at_printf("AT+CFUN=31");
	if (err) {
		return err;
	}
	nrf_modem_gnss_event_handler_set(gnss_evt);
	nrf_modem_gnss_fix_interval_set(1); /* continuous */
	err = nrf_modem_gnss_start();
	if (err) {
		return err;
	}

	int64_t deadline = k_uptime_get() + (int64_t)timeout_s * 1000;

	while (k_uptime_get() < deadline) {
		if (k_sem_take(&pvt_sem, K_SECONDS(2))) {
			continue;
		}
		if (nrf_modem_gnss_read(&pvt, sizeof(pvt), NRF_MODEM_GNSS_DATA_PVT)) {
			continue;
		}
		out->n_tracked = 0;
		out->best_cn0_dbhz_x10 = 0;
		for (size_t i = 0; i < NRF_MODEM_GNSS_MAX_SATELLITES; i++) {
			if (pvt.sv[i].sv == 0) {
				continue;
			}
			out->n_tracked++;
			if (pvt.sv[i].cn0 > out->best_cn0_dbhz_x10) {
				out->best_cn0_dbhz_x10 = pvt.sv[i].cn0;
			}
		}
		if (pvt.flags & NRF_MODEM_GNSS_PVT_FLAG_FIX_VALID) {
			out->fix_valid = true;
			out->lat_deg = pvt.latitude;
			out->lon_deg = pvt.longitude;
			out->alt_m = pvt.altitude;
			out->accuracy_m = pvt.accuracy;
			break;
		}
	}
	nrf_modem_gnss_stop();
	return out->fix_valid ? 0 : -ETIMEDOUT;
}
```

## src/lte_gnss.h
```c
/*
 * Modem: LTE-M uplink and built-in GNSS, time-shared on one radio.
 * Plan in bay-station/README.md "Modem and GNSS time-sharing".
 */
#ifndef LTE_GNSS_H_
#define LTE_GNSS_H_

#include <stdbool.h>
#include <stddef.h>
#include <stdint.h>

int lte_gnss_init(void);                       /* nrf_modem_lib_init + system mode */
int modem_at(const char *cmd, char *resp, size_t resp_len);

struct gnss_snapshot {
	bool     fix_valid;
	double   lat_deg, lon_deg;
	float    alt_m, accuracy_m;
	uint8_t  n_tracked;
	uint16_t best_cn0_dbhz_x10; /* as reported by the modem, 0.1 dB-Hz -- verify unit */
};

/* Start GNSS with LTE off (AT+CFUN=31 path) and wait up to timeout_s. */
int gnss_bringup_fix(int timeout_s, struct gnss_snapshot *out);

#endif /* LTE_GNSS_H_ */
```

## src/uwb_array.c
```c
#include "uwb_array.h"

#include <errno.h>
#include <zephyr/device.h>
#include <zephyr/devicetree.h>
#include <zephyr/drivers/gpio.h>
#include <zephyr/drivers/spi.h>
#include <zephyr/kernel.h>
#include <zephyr/logging/log.h>
#include <zephyr/sys/byteorder.h>

LOG_MODULE_REGISTER(uwb_array, LOG_LEVEL_INF);

#define A_NODE(i) DT_NODELABEL(uwb_a##i)
#define CTRL_NODE DT_NODELABEL(uwb_ctrl)

/* The anchors are not peers. Enforce the role map from devicetree at build
 * time: A0 (reg 0, CS0) must be the one and only "center". */
BUILD_ASSERT(DT_ENUM_IDX(A_NODE(0), anchor_role) == 0, "uwb_a0 must be anchor-role = \"center\"");
BUILD_ASSERT(DT_ENUM_IDX(A_NODE(1), anchor_role) == 1, "uwb_a1 must be \"outer\"");
BUILD_ASSERT(DT_ENUM_IDX(A_NODE(2), anchor_role) == 1, "uwb_a2 must be \"outer\"");
BUILD_ASSERT(DT_ENUM_IDX(A_NODE(3), anchor_role) == 1, "uwb_a3 must be \"outer\"");
BUILD_ASSERT(DT_REG_ADDR(A_NODE(0)) == 0 && DT_REG_ADDR(A_NODE(3)) == 3,
	     "anchor index must equal CS index");

/* NOTE: newer Zephyr dropped SPI_DT_SPEC_GET's delay argument; drop the
 * trailing 0 if the pinned NCS release complains. */
#define SPI_OP (SPI_OP_MODE_MASTER | SPI_WORD_SET(8) | SPI_TRANSFER_MSB) /* DW3000 SPI mode 0 */

static const struct spi_dt_spec anchors[UWBRL_N_ANCHORS] = {
	SPI_DT_SPEC_GET(A_NODE(0), SPI_OP, 0),
	SPI_DT_SPEC_GET(A_NODE(1), SPI_OP, 0),
	SPI_DT_SPEC_GET(A_NODE(2), SPI_OP, 0),
	SPI_DT_SPEC_GET(A_NODE(3), SPI_OP, 0),
};

static const struct gpio_dt_spec irqs[UWBRL_N_ANCHORS] = {
	GPIO_DT_SPEC_GET(A_NODE(0), irq_gpios),
	GPIO_DT_SPEC_GET(A_NODE(1), irq_gpios),
	GPIO_DT_SPEC_GET(A_NODE(2), irq_gpios),
	GPIO_DT_SPEC_GET(A_NODE(3), irq_gpios),
};

static const struct gpio_dt_spec rst_n = GPIO_DT_SPEC_GET(CTRL_NODE, reset_gpios);
static const struct gpio_dt_spec wakeup = GPIO_DT_SPEC_GET(CTRL_NODE, wakeup_gpios);
#if DT_NODE_HAS_PROP(CTRL_NODE, tcxo_en_gpios)
static const struct gpio_dt_spec tcxo_en = GPIO_DT_SPEC_GET(CTRL_NODE, tcxo_en_gpios);
#endif

static K_MUTEX_DEFINE(bus_lock);

enum uwb_role uwb_anchor_role(unsigned int idx)
{
	return idx == UWBRL_ANCHOR_A0 ? UWB_ROLE_CENTER : UWB_ROLE_OUTER;
}

int uwb_array_init(void)
{
	if (!gpio_is_ready_dt(&rst_n) || !gpio_is_ready_dt(&wakeup)) {
		return -ENODEV;
	}
	/* RSTn: "May be pulled low by external open drain driver to reset the
	 * DW3000. Must not be pulled high by external source." (DW3000
	 * Datasheet v1.1, pin description table, RSTn row). GPIO_OPEN_DRAIN in the
	 * devicetree makes "inactive" mean high-Z. */
	gpio_pin_configure_dt(&rst_n, GPIO_OUTPUT_INACTIVE);
	gpio_pin_configure_dt(&wakeup, GPIO_OUTPUT_INACTIVE);
#if DT_NODE_HAS_PROP(CTRL_NODE, tcxo_en_gpios)
	gpio_pin_configure_dt(&tcxo_en, GPIO_OUTPUT_ACTIVE);
#endif
	for (unsigned int i = 0; i < UWBRL_N_ANCHORS; i++) {
		if (!spi_is_ready_dt(&anchors[i]) || !gpio_is_ready_dt(&irqs[i])) {
			return -ENODEV;
		}
		gpio_pin_configure_dt(&irqs[i], GPIO_INPUT);
	}
	return 0;
}

int uwb_array_reset(void)
{
	gpio_pin_set_dt(&rst_n, 1);
	k_msleep(1);
	gpio_pin_set_dt(&rst_n, 0);
	/* TODO(fw-m3): replace with the cold/warm-start timing from DW3000
	 * Datasheet v1.1 Figures 21/22 (or poll SPIRDY via the driver). */
	k_msleep(5);
	return 0;
}

int uwb_tcxo_enable(bool on)
{
#if DT_NODE_HAS_PROP(CTRL_NODE, tcxo_en_gpios)
	return gpio_pin_set_dt(&tcxo_en, on ? 1 : 0);
#else
	ARG_UNUSED(on);
	return -ENOTSUP;
#endif
}

int uwb_read_dev_id_raw(unsigned int idx, uint32_t *dev_id)
{
	if (idx >= UWBRL_N_ANCHORS) {
		return -EINVAL;
	}
	struct spi_dt_spec slow = anchors[idx];

	slow.config.frequency = CONFIG_UWBRL_UWB_SPI_SLOW_HZ;

	/* Short-addressed read, base 0x00, RD: header octet 0x00. */
	uint8_t tx[5] = { 0x00, 0, 0, 0, 0 };
	uint8_t rx[5] = { 0 };
	const struct spi_buf txb = { .buf = tx, .len = sizeof(tx) };
	const struct spi_buf rxb = { .buf = rx, .len = sizeof(rx) };
	const struct spi_buf_set txs = { .buffers = &txb, .count = 1 };
	const struct spi_buf_set rxs = { .buffers = &rxb, .count = 1 };

	k_mutex_lock(&bus_lock, K_FOREVER);
	int err = spi_transceive_dt(&slow, &txs, &rxs);

	k_mutex_unlock(&bus_lock);
	if (err) {
		return err;
	}
	*dev_id = sys_get_le32(&rx[1]);
	return 0;
}

int uwb_clock_check(unsigned int idx, bool *pll_locked)
{
	ARG_UNUSED(idx);
	*pll_locked = false;
	return -ENOSYS; /* TODO(fw-m3): needs the multi-instance driver */
}

int uwb_irq_level(unsigned int idx)
{
	return idx < UWBRL_N_ANCHORS ? gpio_pin_get_dt(&irqs[idx]) : -EINVAL;
}
```

## src/uwb_array.h
```c
/*
 * Four DW3210 anchors on one SPI bus. This is the seam where the
 * multi-instance DW3000 driver goes (bay-station/README.md, fw-m3).
 *
 * The Qorvo dwt_uwb_driver API as trimmed by br101 is implicitly
 * single-instance: dwt_readdevid(void), dwt_check_dev_id(void) etc. take no
 * chip handle and act on a global context (deca_device_api.h, 08.02.02).
 * uwb_anchor_select() is where that context gets switched, under a mutex,
 * so nothing above this file ever talks to "the" DW3000.
 */
#ifndef UWB_ARRAY_H_
#define UWB_ARRAY_H_

#include <stdbool.h>
#include <stdint.h>

#include "uwbrl/meas.h"

enum uwb_role {
	UWB_ROLE_CENTER, /* A0 only */
	UWB_ROLE_OUTER,  /* A1-A3 */
};

int  uwb_array_init(void);
int  uwb_array_reset(void);           /* pulse shared UWB_RST_N */
int  uwb_tcxo_enable(bool on);        /* TCXO_EN, -ENOTSUP if not fitted */
enum uwb_role uwb_anchor_role(unsigned int idx);

/*
 * Raw DEV_ID read, no driver involved: short-addressed read of register
 * file 0x00 (header octet 0x00 -- DW3000 Datasheet v1.1 s4.9.4, Figure 16),
 * 4 bytes little-endian, at UWBRL_UWB_SPI_SLOW_HZ. Works in INIT_RC, i.e.
 * WITHOUT the shared reference clock -- so it proves SPI + CS + power +
 * reset, but NOT that the TCXO reaches the chip.
 */
int  uwb_read_dev_id_raw(unsigned int idx, uint32_t *dev_id);

/*
 * Reference-clock check: bring the anchor to IDLE_PLL, which needs the
 * external 38.4 MHz reference (Table 21: "clocked from the PLL"), and read
 * the PLL-lock status. TODO(fw-m3): needs the driver; bit names must come
 * from dwt_uwb_driver source, not memory.
 */
int  uwb_clock_check(unsigned int idx, bool *pll_locked);

int  uwb_irq_level(unsigned int idx);

#endif /* UWB_ARRAY_H_ */
```
