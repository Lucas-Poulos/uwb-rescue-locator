## firmware/boards/uwbrl/bay_station_lte/Kconfig.bay_station_lte
```kconfig
# Mirrors upstream boards/nordic/nrf9151dk/Kconfig.nrf9151dk.
config BOARD_BAY_STATION_LTE
	select SOC_NRF9151_LACA
```

## firmware/dts/bindings/uwbrl,bridge-ctrl.yaml
```yaml
description: |
  Side-band lines of the nRF9151 <-> BT840 bridge UART (docs/net-contract.md
  s5). Used on both chips: on the nRF9151 irq-gpios is an input and
  reset-gpios drives RESET_BLE_N; on the BT840 irq-gpios is an output and
  there is no reset-gpios.

compatible: "uwbrl,bridge-ctrl"

properties:
  uart:
    type: phandle
    required: true
    description: The UARTE instance carrying BRIDGE_TXD/RXD/RTS/CTS.
  irq-gpios:
    type: phandle-array
    required: true
    description: BRIDGE_IRQ (BT840 -> nRF9151 attention).
  reset-gpios:
    type: phandle-array
    description: RESET_BLE_N (nRF9151 side only; open-drain).
```

## firmware/dts/bindings/uwbrl,dw3210-anchor.yaml
```yaml
description: |
  One DW3210 UWB transceiver on the bay station's shared anchor SPI bus.
  Project-local binding: the DW3000 driver we start from
  (br101/zephyr-dw3000-decadriver) uses "decawave,dw3000" for a single chip
  and owns RST/WAKEUP per node; here those lines are shared across four
  chips (see uwbrl,uwb-array-ctrl), so the node only carries what is
  per-anchor: chip select (reg), IRQ, and role.

compatible: "uwbrl,dw3210-anchor"

include: spi-device.yaml

properties:
  anchor-role:
    type: string
    required: true
    enum:
      - "center"   # A0: DS-TWR with the tag, TDoA reference
      - "outer"    # A1-A3: TDoA vs A0 only
    description: |
      The anchors are not peers. Exactly one node must be "center"; the
      application asserts this at build time.

  irq-gpios:
    type: phandle-array
    required: true
    description: UWB_IRQn from this anchor (DW3000 IRQ pin, active high by default).
```

## firmware/dts/bindings/uwbrl,gpio-set.yaml
```yaml
description: |
  A named list of plain GPIO inputs (e.g. sensor interrupt lines) that the
  bring-up shell reads by name before any sensor driver owns them.

compatible: "uwbrl,gpio-set"

properties:
  gpios:
    type: phandle-array
    required: true
  gpio-names:
    type: string-array
    required: true
    description: One docs/net-contract.md net name per gpios entry.
```

## firmware/dts/bindings/uwbrl,uwb-array-ctrl.yaml
```yaml
description: |
  Control lines shared by all four bay-station DW3210 anchors, plus the
  shared reference-clock enable. Net names per docs/net-contract.md s2/s3.

compatible: "uwbrl,uwb-array-ctrl"

properties:
  reset-gpios:
    type: phandle-array
    required: true
    description: UWB_RST_N. Open-drain; each anchor joins through its own 0R.
  wakeup-gpios:
    type: phandle-array
    required: true
    description: UWB_WAKEUP, shared.
  sync-gpios:
    type: phandle-array
    description: UWB_SYNC (SYNC/OSTR), shared. Whether it is needed is open.
  tcxo-en-gpios:
    type: phandle-array
    description: TCXO_EN. Absent if the chosen TCXO has no enable pin.
```
